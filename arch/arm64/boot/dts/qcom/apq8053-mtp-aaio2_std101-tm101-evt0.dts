/*
 * Copyright (c) 2015-2016, The Linux Foundation. All rights reserved.
 *
 * This program is free software; you can redistribute it and/or modify
 * it under the terms of the GNU General Public License version 2 and
 * only version 2 as published by the Free Software Foundation.
 *
 * This program is distributed in the hope that it will be useful,
 * but WITHOUT ANY WARRANTY; without even the implied warranty of
 * MERCHANTABILITY or FITNESS FOR A PARTICULAR PURPOSE.  See the
 * GNU General Public License for more details.
 */

/dts-v1/;

#include "apq8053.dtsi"
#include "msm8953-mtp.dtsi"
#include "apq8053-oem.dtsi"
#include "apq8053-mtp-lvds-hdmi.dtsi"//Leo Guo add to support all panel in one image
#include "apq8053-mtp-aaio2.dtsi"

/ {
	model = "Qualcomm Technologies, Inc. APQ8053 MTP 10 - aaio2 std101-tm101 evt0";
	compatible = "qcom,apq8053-mtp", "qcom,apq8053", "qcom,mtp";
	qcom,board-id= <0x00420108 0>;
};

&dsi_sn65dsi85_720p {
	qcom,panel-supply-entries = <&dsi_panel_pwr_supply>;
};

&mdss_dsi0 {
	qcom,dsi-pref-prim-pan = <&dsi_sn65dsi85_720p>;
};

/* evt0 declares no touch controller - matches Elo's own DTS */
