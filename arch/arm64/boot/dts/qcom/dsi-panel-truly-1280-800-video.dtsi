/* Copyright (c) 2015-2016, 2018, The Linux Foundation. All rights reserved.
 *
 * This program is free software; you can redistribute it and/or modify
 * it under the terms of the GNU General Public License version 2 and
 * only version 2 as published by the Free Software Foundation.
 *
 * This program is distributed in the hope that it will be useful,
 * but WITHOUT ANY WARRANTY; without even the implied warranty of
 * MERCHANTABILITY or FITNESS FOR A PARTICULAR PURPOSE.  See the
 * GNU General Public License for more details.
 */

&mdss_mdp {
	dsi_truly_1280_800_vid: qcom,mdss_dsi_truly_1080p_video {
		qcom,mdss-dsi-panel-name = "truly 1080p video mode dsi panel";
		qcom,mdss-dsi-panel-type = "dsi_video_mode";
		qcom,mdss-dsi-panel-framerate = <60>;
		qcom,mdss-dsi-virtual-channel-id = <0>;
		qcom,mdss-dsi-stream = <0>;
		qcom,mdss-dsi-panel-width = <800>;
		qcom,mdss-dsi-panel-height = <1280>;
		qcom,mdss-dsi-h-front-porch = <44>;
		qcom,mdss-dsi-h-back-porch = <44>;
		qcom,mdss-dsi-h-pulse-width = <4>;
		qcom,mdss-dsi-h-sync-skew = <0>;
		qcom,mdss-dsi-v-back-porch = <16>;
		qcom,mdss-dsi-v-front-porch = <14>;
		qcom,mdss-dsi-v-pulse-width = <2>;
		qcom,mdss-dsi-h-left-border = <0>;
		qcom,mdss-dsi-h-right-border = <0>;
		qcom,mdss-dsi-v-top-border = <0>;
		qcom,mdss-dsi-v-bottom-border = <0>;
		qcom,mdss-dsi-bpp = <24>;
		qcom,mdss-dsi-underflow-color = <0xff>;
		qcom,mdss-dsi-border-color = <0>;
		qcom,mdss-dsi-h-sync-pulse = <0>;
		qcom,mdss-dsi-traffic-mode = "burst_mode";
		qcom,mdss-dsi-bllp-eof-power-mode;
		qcom,mdss-dsi-bllp-power-mode;
		qcom,mdss-dsi-lane-0-state;
		qcom,mdss-dsi-lane-1-state;
		qcom,mdss-dsi-lane-2-state;
		qcom,mdss-dsi-lane-3-state;
		qcom,mdss-dsi-panel-timings =
			[e6 38 26 00 68 6e 2a 3c 44 03 04 00];
		qcom,mdss-dsi-t-clk-post = <0x02>;
		qcom,mdss-dsi-t-clk-pre = <0x2d>;
		qcom,mdss-dsi-bl-min-level = <1>;
		qcom,mdss-dsi-bl-max-level = <4095>;
		qcom,mdss-dsi-dma-trigger = "trigger_sw";
		qcom,mdss-dsi-mdp-trigger = "none";
		qcom,mdss-dsi-on-command = [15 01 00 00 00 00 02 90 90
     15 01 00 00 00 00 02 92 31
     15 01 00 00 00 00 02 D8 66
     29 01 00 00 00 00 13 19 00 00 FC B5 F2 BF FF FB BF 91 00 00 00 1C F8 1F 01 FB
     29 01 00 00 00 00 13 19 10 00 92 5E 90 00 A0 2C 55 02 69 CE 64 59 20 0A DF 37
     29 01 00 00 00 00 13 19 20 00 E9 9D A7 87 C2 F7 4D 7E 17 A4 39 93 95 54 A1 50 
     29 01 00 00 00 00 13 19 30 00 20 40 48 11 BA 54 E0 48 06 00 00 00 00 0E 7F 3F
     29 01 00 00 00 00 13 19 40 00 84 18 40 30 14 C2 FF 37 AC 04 00 00 78 89 03 C0
     29 01 00 00 00 00 13 19 50 00 00 62 80 00 E2 29 C2 86 14 21 FB 01 3C 00 14 64
     29 01 00 00 00 00 13 19 60 00 64 A0 10 0A 1E 1C 36 9C 08 01 3A 1E 80 91 02 3C
     29 01 00 00 00 00 13 19 70 00 86 3F 63 20 40 BA 86 8C 43 18 FE FE FE FE FE FE
     29 01 00 00 00 00 13 19 80 00 FE FE FE FE 00 01 01 01 01 01 01 01 01 01 01 E8
     29 01 00 00 00 00 13 19 90 00 0F 09 01 00 3C 20 85 24 0D 00 00 00 80 E6 66 00
     29 01 00 00 00 00 13 19 A0 00 00 00 00 00 00 2D 5A 00 00 00 00 00 00 88 60 20
     29 01 00 00 00 00 13 19 B0 00 28 50 A0 40 81 82 82 82 02 00 00 00 00 00 00 00
     29 01 00 00 00 00 13 19 C0 00 00 94 28 51 A2 44 49 49 49 09 00 00 00 00 00 00
     29 01 00 00 00 00 13 19 D0 00 00 00 00 03 3C 64 6E 00 00 00 00 00 82 82 14 14
     29 01 00 00 00 00 13 19 E0 00 82 82 14 14 A5 5A 96 96 A5 5A 96 96 EB EB 7D 7D
     29 01 00 00 00 00 13 19 F0 00 EB EB 7D 7D 00 00 12 84 00 00 48 21 12 84 48 21
     29 01 00 00 00 00 07 19 DC 01 21 48 84 12
     29 01 00 00 00 00 13 19 E0 01 12 84 69 69 48 21 A5 5A 69 69 A5 5A 96 96 5A A5
     29 01 00 00 00 00 13 19 F0 01 69 69 DE B7 A5 5A 7B ED DE B7 7B ED ED 7B B7 DE
     05 01 00 00 14 00 02 29 00];
		qcom,mdss-dsi-off-command = [05 01 00 00 14 00 02 28 00
				 05 01 00 00 78 00 02 10 00];
		qcom,mdss-dsi-on-command-state = "dsi_lp_mode";
		qcom,mdss-dsi-off-command-state = "dsi_lp_mode";
		qcom,mdss-dsi-bl-pmic-control-type = "bl_ctrl_pwm";
		qcom,mdss-dsi-bl-pmic-pwm-frequency = <100>;
		qcom,mdss-dsi-bl-pmic-bank-select = <0>;
		qcom,panel-supply-entries = <&dsi_panel_pwr_supply>;
		qcom,mdss-dsi-reset-sequence = <0 100>, <1 100>, <0 100>;
		qcom,mdss-dsi-tx-eot-append;
		qcom,mdss-dsi-post-init-delay = <1>;
	};
};
